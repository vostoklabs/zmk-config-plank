## boards/shields/planck_hw/Kconfig.defconfig
```kconfig
# Copyright (c) 2024 The ZMK Contributors
# SPDX-License-Identifier: MIT

if SHIELD_PLANCK_HW

config ZMK_KEYBOARD_NAME
    default "Planck HW"

endif
```

## boards/shields/planck_hw/Kconfig.shield
```kconfig
# Copyright (c) 2024 The ZMK Contributors
# SPDX-License-Identifier: MIT

config SHIELD_PLANCK_HW
    def_bool $(shields_list_contains,planck_hw)
```
